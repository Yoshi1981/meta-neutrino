## conf/distro/tuxbox.conf
```bitbake
# This is the tuxbox-neutrino build based on yocto poky

DISTRO_NAME ?= "${DISTRO}"
DISTRO_VERSION_NUMBER_MAJOR ?= "3"
DISTRO_VERSION_NUMBER_MINOR ?= "2"
DISTRO_VERSION_NUMBER_MICRO ?= "4"
DISTRO_VERSION_NUMBER_CYCLE ?= "${DISTRO_VERSION_NUMBER_MAJOR}${DISTRO_VERSION_NUMBER_MINOR}${DISTRO_VERSION_NUMBER_MICRO}"
DISTRO_VERSION ?= "${DISTRO_VERSION_NUMBER_MAJOR}.${DISTRO_VERSION_NUMBER_MINOR}.${DISTRO_VERSION_NUMBER_MICRO}"
DISTRO_TYPE ?= "beta"

BUILD_VERSION = "${@time.strftime('%Y%m%d%H%M%S',time.localtime())}"

SDK_NAME ?= "neutrino-image"
SDK_VERSION = "${DISTRO_VERSION}"


IMAGE_BASENAME ?= "${DISTRO_NAME}"
IMAGE_NAME ?= "${IMAGE_BASENAME}-${MACHINE_BRAND}-${MACHINE_NAME}-${DISTRO_VERSION}${IMAGE_VERSION_SUFFIX}"

CREATOR ?= "${USER}"
KBUILD_BUILD_USER ?= "${CREATOR}"

PACKAGE_EXTRA_ARCHS += "allarch"

GIT_USER ?= "root"
MAIL ?= "root@${MACHINE}"

IMAGESIZE ?= "normal"

RM_WORK_EXCLUDE += "neutrino-mp neutrino-image base-files neutrino-feed-config"

#  Which neutrino source will be used:
#  Choose neutrino source. Possible values are "tuxbox", "tango" or "ni"
#  Note: Successful build of foreign neutrino source is not guaranteed.
FLAVOUR ?= "tuxbox"

DEFAULT_TIMEZONE ?= "Europe/Berlin"

TCLIBC ?= "glibc"
TCLIBCAPPEND ?= ""
TMPDIR .= "${TCLIBCAPPEND}"
TMPDIR ?= "${TOPDIR}/tmp"

RELEASE_TEXT_FILE_NAME ?= "beta.txt"

QA_LOGFILE = "${TMPDIR}/qa.log"

OEINCLUDELOGS ?= "yes"
PATCHRESOLVE = "noop"

PRSERV_HOST = "localhost:0"

# release state: default beta
RELEASE_STATE = "0"


### Update server configuration
#   where do find the buildsystem the distro type file (beta.txt, release.txt ...), this file contains list of image urls for download
RELEASE_TEXT_LOCATION_FILE = "${DEPLOY_DIR_IMAGE}/${DISTRO_TYPE}.txt"

## Server URL which contains update and packages.
#  Web server must be running and html content must point to the toplevel directory which contains the deployed images
#  NOTE: @hostname@ is only a placeholder and will be replaced with current hostname of your build host automatically. @hostname@ could be the current host IP too. 
#  or any other domain.tld. If required, replace @hostname@ with the host IP or Domain.
UPDATE_SERVER_URL ?= "http://@hostname@"

## URL to the dist directory, must contain the content of the deployed images and packages
DIST_URL ?= "${UPDATE_SERVER_URL}/dist"

## URL to the images, must contain the content of the image dir and its a sub dir to specific machine build and image dir which contains machine images
IMAGE_LOCATION_URL ?= "${DIST_URL}/${DISTRO_VERSION}/@build-dirname@/images/${MACHINE}"

## URL to package feed
IPK_FEED_SERVER ?= "${DIST_URL}/${DISTRO_VERSION}/@build-dirname@/ipk"

KERNEL_CONSOLE ?= "ttyS0"
KEEPUIMAGE ??= "yes"

IMAGE_LINGUAS ?= "en-us de-de fr-fr"
ENABLE_BINARY_LOCALE_GENERATION ?= "1"
LOCALE_UTF8_IS_DEFAULT ?= "1"
LOCALE_UTF8_ONLY ?= "0"
LOCALE_UTF8_IS_DEFAULT_class-nativesdk = "0"

BB_GENERATE_MIRROR_TARBALLS ??= "0"
BBINCLUDELOGS ??= "yes"
BB_STRICT_CHECKSUM = "1"
NO32LIBS ??= "1"

USER_CLASSES ?= "buildstats image-mklibs image-prelink"

DISTRO_FEATURES_DEFAULT ?= "acl alsa argp bluetooth ext2 irda largefile pam systemd usbgadget usbhost wifi xattr nfs zeroconf nfc"
DISTRO_FEATURES_LIBC_DEFAULT ?= "ipv4 ipv6 libc-backtrace libc-big-macros libc-bsd libc-cxx-tests libc-catgets libc-charsets libc-crypt \
					libc-crypt-ufc libc-db-aliases libc-envz libc-fcvt libc-fmtmsg libc-fstab libc-ftraverse \
					libc-getlogin libc-idn libc-inet-anl libc-libm libc-locales libc-locale-code \
					libc-memusage libc-nis libc-nsswitch libc-rcmd libc-rtld-debug libc-spawn libc-streams libc-sunrpc \
					libc-utmp libc-utmpx libc-wordexp libc-posix-clang-wchar libc-posix-regexp libc-posix-regexp-glibc \
					libc-posix-wchar-io"
DISTRO_FEATURES_LIBC ?= "${DISTRO_FEATURES_LIBC_DEFAULT}"
DISTRO_FEATURES_LIBC_class-nativesdk = "${DISTRO_FEATURES_LIBC_DEFAULT}"
DISTRO_FEATURES ?= "${DISTRO_FEATURES_DEFAULT} ${DISTRO_FEATURES_LIBC}"
USE_NONFREE ?="yes"
IMAGE_FEATURES ?= ""
EXTRA_IMAGE_FEATURES ?= "debug-tweaks package-management"

require conf/distro/include/yocto-uninative.inc
INHERIT += "uninative"

WHITELIST_GPL-3.0 ?= ""
LGPLv2_WHITELIST_GPL-3.0 ?= ""

COMMERCIAL_AUDIO_PLUGINS ?= ""
# COMMERCIAL_AUDIO_PLUGINS ?= "gst-plugins-ugly-mad gst-plugins-ugly-mpegaudioparse"
COMMERCIAL_VIDEO_PLUGINS ?= ""
# COMMERCIAL_VIDEO_PLUGINS ?= "gst-plugins-ugly-mpeg2dec gst-plugins-ugly-mpegstream gst-plugins-bad-mpegvideoparse"
# Set of common licenses used for license.bbclass
#COMMON_LICENSE_DIR ??= "${COREBASE}/meta/files/common-licenses"

# Allow java, svn and unzip executed on host
HOSTTOOLS += "svn unzip xmlcatalog doxygen"

DISTRO_FEATURES_append = " systemd"
DISTRO_FEATURES_BACKFILL_CONSIDERED += "sysvinit pulseaudio"
VIRTUAL-RUNTIME_init_manager = "systemd"
VIRTUAL-RUNTIME_initscripts = "systemd-compat-units"
VIRTUAL-RUNTIME_login_manager = "shadow-base"
MACHINE_FEATURES_BACKFILL_CONSIDERED = "rtc"

# workaround: cant build sdl against glx
ASSUME_PROVIDED += "libsdl2-native nativesdk-libsdl2"

LICENSE_FLAGS_WHITELIST="commercial"

PREFERRED_PROVIDER_virtual/lua = "luajit"

PREFERRED_VERSION_ffmpeg = "4.3.2"
PREFERRED_VERSION_virtual/lua = "2.1"
PREFERRED_VERSION_libupnp = "1.6.25"

SANITY_TESTED_DISTROS ?= " \
	poky-2.3-snapshot-20170912 \n \
	poky-2.6 \n \
	poky-2.7 \n \
	ubuntu-16.04 \n \
	ubuntu-18.04 \n \
	ubuntu-19.04 \n \
	ubuntu-19.10 \n \
	ubuntu-20.04 \n \
	fedora-28 \n \
	fedora-29 \n \
	fedora-30 \n \
	fedora-31 \n \
	fedora-32 \n \
	fedora-33 \n \
	centos-7 \n \
	debian-8 \n \
	debian-9 \n \
	debian-10 \n \
	debian-11 \n \
	opensuseleap-15.1 \n \
"


#TARGET_CFLAGS = "${TARGET_CPPFLAGS} ${SELECTED_OPTIMIZATION}"
# 
#DEBUG_FLAGS ?= "-g -feliminate-used-debug-types ${DEBUG_PREFIX_MAP} "
# 
#DEBUG_OPTIMIZATION = "-Og ${DEBUG_FLAGS -pipe}"
#SELECTED_OPTIMIZATION = "${@d.getVar(oe.utils.vartrue('DEBUG_BUILD', 'DEBUG_OPTIMIZATION', 'FULL_OPTIMIZATION', d))}"

# OE optimization defaults to -O2 which makes for much larger binaries.
# Override here to use -Os instead, resulting in smaller images.
FULL_OPTIMIZATION = "-Os -pipe ${DEBUG_FLAGS}"

# Some targets need O2, avoids build errors
O2_OPT = "-O2 -pipe ${DEBUG_FLAGS}"
FULL_OPTIMIZATION_pn-gd = "${O2_OPT}"

# build some core libs with better compiler optimization for better performance
O3_OPT = "-O3 -pipe ${DEBUG_FLAGS}"
FULL_OPTIMIZATION_pn-flac = "${O3_OPT}"
FULL_OPTIMIZATION_pn-jpeg = "${O3_OPT}"
FULL_OPTIMIZATION_pn-lame = "${O3_OPT}"
FULL_OPTIMIZATION_pn-liba52 = "${O3_OPT}"
FULL_OPTIMIZATION_pn-libdca = "${O3_OPT}"
FULL_OPTIMIZATION_pn-libgcrypt = "${O3_OPT}"
FULL_OPTIMIZATION_pn-libmad = "${O3_OPT}"
FULL_OPTIMIZATION_pn-libogg = "${O3_OPT}"
FULL_OPTIMIZATION_pn-libpng = "${O3_OPT}"
FULL_OPTIMIZATION_pn-libsamplerate = "${O3_OPT}"
FULL_OPTIMIZATION_pn-libvorbis = "${O3_OPT}"
FULL_OPTIMIZATION_pn-tremor = "${O3_OPT}"
FULL_OPTIMIZATION_pn-zlib = "${O3_OPT}"
```
